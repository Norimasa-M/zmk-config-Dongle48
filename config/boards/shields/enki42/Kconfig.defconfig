## config/boards/shields/enki42/Kconfig.defconfig
```kconfig
# Copyright (c) 2020 The ZMK Contributors
# SPDX-License-Identifier: MIT

if SHIELD_NMORTHO48_DONGLE

config ZMK_KEYBOARD_NAME
	default "nmrotho48 Dongle"
	
config ZMK_SPLIT_BLE_ROLE_CENTRAL
	default y
	
config ZMK_USB
	default y

endif

if SHIELD_nmrotho48_LEFT || SHIELD_nmrotho48_RIGHT || SHIELD_nmrotho48_DONGLE 

config ZMK_SPLIT
	default y

config ZMK_BLE
	default y
	
endif
```

## config/boards/shields/enki42/Kconfig.shield
```kconfig
# Copyright (c) 2020 The ZMK Contributors
# SPDX-License-Identifier: MIT

config SHIELD_nmrotho48_LEFT
	def_bool $(shields_list_contains,nmrotho48_left)

config SHIELD_nmrotho48_RIGHT
	def_bool $(shields_list_contains,nmrotho48_right)

config SHIELD_nmrotho48_DONGLE
	def_bool $(shields_list_contains,nmrotho48_dongle)
```

## config/boards/shields/nmortho48/Kconfig.shield
```kconfig
# Copyright (c) 2020 The ZMK Contributors
# SPDX-License-Identifier: MIT

config SHIELD_nmortho48_LEFT
	def_bool $(shields_list_contains,nmortho48_left)

config SHIELD_nmortho48_RIGHT
	def_bool $(shields_list_contains,nmortho48_right)

config SHIELD_nmortho48_DONGLE
	def_bool $(shields_list_contains,nmortho48_dongle)
```
